## main/Kconfig.projbuild
```kconfig
# put here your custom config value
menu "Example Configuration"

config LED_GPIO
    int "LED GPIO number"
    range 0 48
    default 2
    help
    LED GPIO.

config SDA_GPIO
    int "SDA GPIO number"
    range 0 48
    default 21
    help
        GPIO number SDA.
 
config SCL_GPIO
    int "SCL GPIO number"
    range 0 48
    default 22
    help
        GPIO number SCL.

config ESP_WIFI_SSID
    string "WiFi SSID"
    default "RT-GPON-61B0"
    help
	SSID (network name) for the example to connect to.

config ESP_WIFI_PASSWORD
    string "WiFi Password"
    default "mypassword"
    help
	WiFi password (WPA or WPA2) for the example to use.

choice WIFI_SCAN_METHOD
    prompt "WiFi Scan Method"
    default WIFI_SCAN_METHOD_ALL_CHANNEL
    help
        WiFi scan method:
 
        If "Fast" is selected, scan will end after find SSID match AP.
 
        If "All Channel" is selected, scan will end after scan all the channel.
 
    config WIFI_SCAN_METHOD_FAST
        bool "Fast"
    config WIFI_SCAN_METHOD_ALL_CHANNEL
        bool "All Channel"
endchoice
 
choice WIFI_CONNECT_AP_SORT_METHOD
	prompt "WiFi Connect AP Sort Method"
	default WIFI_CONNECT_AP_BY_SIGNAL
	help
		WiFi connect AP sort method:
 
		If "Signal" is selected, Sort matched APs in scan list by RSSI.
 
		If "Security" is selected, Sort matched APs in scan list by security mode.
 
	config WIFI_CONNECT_AP_BY_SIGNAL
		bool "Signal"
	config WIFI_CONNECT_AP_BY_SECURITY
		bool "Security"
endchoice
 
config WIFI_SCAN_RSSI_THRESHOLD
	int "WiFi minimum rssi"
	range -127 0
 
	default -127
	help
		The minimum rssi to accept in the scan mode.
 
choice WIFI_SCAN_AUTH_MODE_THRESHOLD
	prompt "WiFi Scan auth mode threshold"
	default WIFI_AUTH_OPEN
	help
		The weakest authmode to accept in the scan mode.
 
	config WIFI_AUTH_OPEN
		bool "OPEN"
	config WIFI_AUTH_WEP
		bool "WEP"
	config WIFI_AUTH_WPA_PSK
		bool "WPA PSK"
	config WIFI_AUTH_WPA2_PSK
		bool "WPA2 PSK"
	config WIFI_AUTH_WPA_WPA2_PSK
		bool "WPA WPA2 PSK"
	config WIFI_AUTH_WPA2_ENTERPRISE
		bool "WPA2 ENTERPRISE"
	config WIFI_AUTH_WPA3_PSK
		bool "WPA3 PSK"
	config WIFI_AUTH_WPA2_WPA3_PSK
		bool "WPA2 WPA3 PSK"
	config WIFI_AUTH_WAPI_PSK
		bool "WAPI PSK"
endchoice

config SERVER_IP
    string "SERVER IPV4 Address"
    default "192.168.0.13"
    help
        SERVER IPV4 Address.
 
config SERVER_PORT
    int "Server Port"
    range 0 65535
    default 3333
    help
        The remote port.
 
config CLIENT_PORT
    int "Client Port"
    range 0 65535
    default 4444
    help
        The local port.

endmenu
```
